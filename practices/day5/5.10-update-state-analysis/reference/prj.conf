## CMakeLists.txt
```
cmake_minimum_required(VERSION 3.20.0)

find_package(Zephyr REQUIRED HINTS $ENV{ZEPHYR_BASE})
project(day5_update_state_analysis)

target_sources(app PRIVATE src/main.c)
```

## prj.conf
```kconfig
CONFIG_PRINTK=y
CONFIG_BUILD_OUTPUT_BIN=y
```

## src/main.c
```c
#include <zephyr/app_version.h>
#include <zephyr/kernel.h>
#include <zephyr/sys/printk.h>

int main(void)
{
	printk("UPDATE_ANALYSIS base_payload=%s target=native_sim\n",
	       APP_VERSION_EXTENDED_STRING);
	return 0;
}
```
