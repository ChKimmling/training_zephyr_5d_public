## prj.conf
```kconfig
CONFIG_PRINTK=y
CONFIG_PM_DEVICE=y
CONFIG_PM_DEVICE_RUNTIME=y
CONFIG_MAIN_STACK_SIZE=2048
```

## src/main.c
```c
/* SPDX-License-Identifier: Apache-2.0 */

#include "training_sensor.h"

#include <errno.h>
#include <zephyr/device.h>
#include <zephyr/kernel.h>
#include <zephyr/pm/device.h>
#include <zephyr/pm/device_runtime.h>
#include <zephyr/sys/printk.h>

static const char *state_name(enum pm_device_state state)
{
	switch (state) {
	case PM_DEVICE_STATE_ACTIVE:
		return "ACTIVE";
	case PM_DEVICE_STATE_SUSPENDED:
		return "SUSPENDED";
	case PM_DEVICE_STATE_SUSPENDING:
		return "SUSPENDING";
	case PM_DEVICE_STATE_OFF:
		return "OFF";
	default:
		return "UNKNOWN";
	}
}

static void print_snapshot(const char *label, const struct device *dev)
{
	enum pm_device_state state = PM_DEVICE_STATE_OFF;
	int ret = pm_device_state_get(dev, &state);

	printk("SNAPSHOT %-18s state=%s usage=%d busy=%d transitions=%u state_ret=%d\n", label,
	       state_name(state), pm_device_runtime_usage(dev), pm_device_is_busy(dev),
	       training_sensor_transition_count(dev), ret);
}

static int runtime_pm_enable(const struct device *dev)
{
	return pm_device_runtime_enable(dev);
}

static int sensor_acquire(const struct device *dev)
{
	return pm_device_runtime_get(dev);
}

static int sensor_release(const struct device *dev)
{
	return pm_device_runtime_put(dev);
}

static int critical_operation(const struct device *dev)
{
	int32_t value_milli = 0;
	int ret;

	pm_device_busy_set(dev);
	ret = training_sensor_read(dev, &value_milli);
	printk("CRITICAL busy=%d read_ret=%d value_milli=%d\n", pm_device_is_busy(dev), ret,
	       value_milli);
	pm_device_busy_clear(dev);

	return ret;
}

int main(void)
{
	const struct device *sensor = training_sensor_device();
	int32_t value_milli = 0;
	int ret;

	printk("POWER_MANAGEMENT device_ready=%d\n", device_is_ready(sensor));
	print_snapshot("after-init", sensor);

	ret = runtime_pm_enable(sensor);
	printk("STEP enable ret=%d\n", ret);
	print_snapshot("after-enable", sensor);

	ret = sensor_acquire(sensor);
	printk("STEP get-1 ret=%d\n", ret);
	print_snapshot("after-get-1", sensor);

	ret = training_sensor_read(sensor, &value_milli);
	printk("READ ret=%d value_milli=%d\n", ret, value_milli);

	ret = sensor_acquire(sensor);
	printk("STEP get-2 ret=%d\n", ret);
	print_snapshot("after-get-2", sensor);

	(void)critical_operation(sensor);
	print_snapshot("after-critical", sensor);

	ret = sensor_release(sensor);
	printk("STEP put-1 ret=%d\n", ret);
	print_snapshot("after-put-1", sensor);

	ret = sensor_release(sensor);
	printk("STEP put-2 ret=%d\n", ret);
	print_snapshot("after-put-2", sensor);

	ret = sensor_release(sensor);
	printk("STEP put-unbalanced ret=%d\n", ret);
	print_snapshot("final", sensor);

	return 0;
}
```

## src/training_sensor.c
```c
/* SPDX-License-Identifier: Apache-2.0 */

#include "training_sensor.h"

#include <errno.h>
#include <stdbool.h>
#include <zephyr/init.h>
#include <zephyr/pm/device.h>
#include <zephyr/sys/printk.h>

struct training_sensor_data {
	bool active;
	uint32_t transitions;
	uint32_t samples;
};

static int training_sensor_pm_action(const struct device *dev, enum pm_device_action action)
{
	struct training_sensor_data *data = dev->data;

	switch (action) {
	case PM_DEVICE_ACTION_SUSPEND:
		data->active = false;
		break;
	case PM_DEVICE_ACTION_RESUME:
		data->active = true;
		break;
	default:
		return -ENOTSUP;
	}

	data->transitions++;
	printk("DRIVER action=%s transitions=%u\n",
	       action == PM_DEVICE_ACTION_SUSPEND ? "SUSPEND" : "RESUME", data->transitions);

	return 0;
}

static int training_sensor_init(const struct device *dev)
{
	struct training_sensor_data *data = dev->data;

	data->active = true;
	data->transitions = 0U;
	data->samples = 0U;

	return 0;
}

PM_DEVICE_DEFINE(training_sensor_pm, training_sensor_pm_action);

static struct training_sensor_data training_sensor_data;

DEVICE_DEFINE(training_sensor, "training_sensor", training_sensor_init,
	      PM_DEVICE_GET(training_sensor_pm), &training_sensor_data, NULL, POST_KERNEL,
	      CONFIG_KERNEL_INIT_PRIORITY_DEVICE, NULL);

const struct device *training_sensor_device(void)
{
	return DEVICE_GET(training_sensor);
}

int training_sensor_read(const struct device *dev, int32_t *value_milli)
{
	struct training_sensor_data *data = dev->data;

	if (value_milli == NULL) {
		return -EINVAL;
	}
	if (!data->active) {
		return -EACCES;
	}

	data->samples++;
	*value_milli = 20000 + (int32_t)(data->samples * 125U);

	return 0;
}

uint32_t training_sensor_transition_count(const struct device *dev)
{
	const struct training_sensor_data *data = dev->data;

	return data->transitions;
}
```

## src/training_sensor.h
```c
/* SPDX-License-Identifier: Apache-2.0 */

#ifndef TRAINING_SENSOR_H_
#define TRAINING_SENSOR_H_

#include <stdint.h>
#include <zephyr/device.h>

const struct device *training_sensor_device(void);
int training_sensor_read(const struct device *dev, int32_t *value_milli);
uint32_t training_sensor_transition_count(const struct device *dev);

#endif /* TRAINING_SENSOR_H_ */
```
