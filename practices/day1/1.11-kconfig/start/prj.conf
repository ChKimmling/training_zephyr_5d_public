## CMakeLists.txt
```
cmake_minimum_required(VERSION 3.20.0)
find_package(Zephyr REQUIRED HINTS $ENV{ZEPHYR_BASE})
project(day1_kconfig)

target_sources(app PRIVATE src/main.c)
```

## Kconfig
```
mainmenu "Day 1 Kconfig exercise"

source "Kconfig.zephyr"

config TRAINING_LIMIT
	int "Sample limit"
	range 1 100
	default 4

config TRAINING_INTERVAL_MS
	int "Sample interval in milliseconds"
	range 10 5000
	default 250

config TRAINING_VERBOSE_OUTPUT
	bool "Enable diagnostic output"
	default n

config TRAINING_START_ACTIVE
	bool "Start in active state"
	default n
```

## prj.conf
```kconfig
CONFIG_PRINTK=y
CONFIG_TRAINING_LIMIT=4
CONFIG_TRAINING_INTERVAL_MS=250
```

## src/main.c
```c
#include <zephyr/kernel.h>
#include <zephyr/sys/printk.h>
#include <zephyr/sys/util.h>

int main(void)
{
	int count = 0;

	printk("Kconfig starter limit=%d interval=%d ms\n",
	       CONFIG_TRAINING_LIMIT, CONFIG_TRAINING_INTERVAL_MS);
	while (1) {
		printk("sample %d\n", ++count);
		if (IS_ENABLED(CONFIG_TRAINING_VERBOSE_OUTPUT)) {
			printk("diagnostic: start-active=%d\n",
			       IS_ENABLED(CONFIG_TRAINING_START_ACTIVE));
		}
		k_msleep(CONFIG_TRAINING_INTERVAL_MS);
	}
	return 0;
}
```
