/ {
	aliases {
		training-device = &training_device;
	};

	training_device: training-device {
		compatible = "training,simulated-device";
		status = "okay";
		device-name = "day1-sim";
		interval-ms = <250>;
		limit = <4>;
	};
};
