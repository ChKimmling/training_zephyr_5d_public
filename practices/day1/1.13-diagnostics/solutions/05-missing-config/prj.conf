## CMakeLists.txt
```
cmake_minimum_required(VERSION 3.20.0)
find_package(Zephyr REQUIRED HINTS $ENV{ZEPHYR_BASE})
project(day1_diag_missing_config)
target_sources(app PRIVATE src/main.c)
```

## prj.conf
```kconfig
CONFIG_PRINTK=y
CONFIG_TRAINING_LIMIT=4
```

## src/main.c
```c
#include <zephyr/sys/printk.h>

#if CONFIG_TRAINING_LIMIT < 1
#error "Set CONFIG_TRAINING_LIMIT to a positive value in prj.conf"
#endif

int main(void)
{
	printk("limit=%d\n", CONFIG_TRAINING_LIMIT);
	printk("diagnostic case recovered\n");
	return 0;
}
```
