## CMakeLists.txt
```
cmake_minimum_required(VERSION 3.20.0)
find_package(Zephyr REQUIRED HINTS $ENV{ZEPHYR_BASE})
project(portable_motion_monitor)

target_include_directories(app PRIVATE include)
target_sources(app PRIVATE
  src/main.c
  src/sensor_source.c
  src/motion_probe.c
  src/probe_queue.c
  src/app_state.c
  src/connectivity.c
)
```

## prj.conf
```kconfig
CONFIG_SENSOR=y
CONFIG_I2C=y
CONFIG_EMUL=y
CONFIG_BMI160_TRIGGER_NONE=y
CONFIG_LOG=y
CONFIG_LOG_DEFAULT_LEVEL=3
CONFIG_MAIN_STACK_SIZE=4096
CONFIG_NETWORKING=y
CONFIG_NET_MGMT=y
CONFIG_NET_MGMT_EVENT=y
CONFIG_NET_CONNECTION_MANAGER=y
CONFIG_NET_DRIVERS=y
CONFIG_NET_LOOPBACK=y
CONFIG_ETH_NATIVE_TAP=n
CONFIG_NET_IPV4=y
CONFIG_NET_IPV6=n

CONFIG_SHELL=y
CONFIG_NET_SHELL=y
CONFIG_DEVICE_SHELL=y
CONFIG_I2C_SHELL=y
```

## src/main.c
```c
#include <zephyr/kernel.h>
#include <zephyr/logging/log.h>
#include "app_state.h"
#include "connectivity.h"
#include "motion_probe.h"
#include "probe_queue.h"
#include "sensor_source.h"

LOG_MODULE_REGISTER(connectivity_app, LOG_LEVEL_INF);

static int capture(uint32_t sequence)
{
	const struct motion_axes stimulus = {(int32_t)sequence * 100, 0, 9807};
	struct motion_axes axes = {0};
	struct motion_probe probe;
	int rc = sensor_source_set_sample(&stimulus);

	rc = rc < 0 ? rc : sensor_source_read(&axes);
	if (rc < 0) {
		app_state_note_sensor_error();
	}
	motion_probe_build(&probe, &axes, rc, sequence, k_uptime_get());
	return probe_queue_publish_latest(&probe);
}

int main(void)
{
	struct app_state_snapshot state;
	struct motion_probe probe;
	int rc = sensor_source_init();

	app_state_reset();
	probe_queue_reset();
	if (rc == 0) {
		rc = connectivity_init();
	}
	connectivity_emit_for_test(true);
	connectivity_wait_for_work();
	connectivity_emit_for_test(false);
	connectivity_wait_for_work();
	for (uint32_t sequence = 1; rc == 0 && sequence <= 3; ++sequence) {
		rc = capture(sequence);
	}
	while (probe_queue_take(&probe, K_NO_WAIT) == 0) {
		app_state_accept_probe(&probe);
	}
	connectivity_emit_for_test(true);
	connectivity_wait_for_work();
	app_state_get(&state);
	LOG_INF("connected=%d connect=%u disconnect=%u seq=%u processed=%u",
		state.connected, state.connect_transitions, state.disconnect_transitions,
		state.last_probe.sequence, state.processed);
	if (!state.connected || state.connect_transitions != 2U ||
	    state.disconnect_transitions != 1U || state.last_probe.sequence != 3U) {
		LOG_ERR("CONNECTIVITY FAIL");
		return -1;
	}
	LOG_INF("CONNECTIVITY PASS");
	return 0;
}
```

## include/app_state.h
```c
#ifndef DAY4_APP_STATE_H_
#define DAY4_APP_STATE_H_

#include <stdbool.h>
#include <stdint.h>

#include "motion_probe.h"

struct app_state_snapshot {
	bool has_probe;
	struct motion_probe last_probe;
	uint32_t processed;
	uint32_t sensor_errors;
	uint32_t queue_drops;
	uint32_t sequence_gaps;
	bool connected;
	uint32_t connect_transitions;
	uint32_t disconnect_transitions;
};

void app_state_reset(void);
void app_state_note_sensor_error(void);
void app_state_note_queue_drop(void);
void app_state_accept_probe(const struct motion_probe *probe);
void app_state_get(struct app_state_snapshot *snapshot);
void app_state_set_connected(bool connected);

#endif
```

## src/app_state.c
```c
#include "app_state.h"

#include <string.h>

#include <zephyr/kernel.h>

static K_MUTEX_DEFINE(state_lock);
static struct app_state_snapshot state;

void app_state_reset(void)
{
	k_mutex_lock(&state_lock, K_FOREVER);
	memset(&state, 0, sizeof(state));
	k_mutex_unlock(&state_lock);
}

void app_state_note_sensor_error(void)
{
	k_mutex_lock(&state_lock, K_FOREVER);
	state.sensor_errors++;
	k_mutex_unlock(&state_lock);
}

void app_state_note_queue_drop(void)
{
	k_mutex_lock(&state_lock, K_FOREVER);
	state.queue_drops++;
	k_mutex_unlock(&state_lock);
}

void app_state_accept_probe(const struct motion_probe *probe)
{
	k_mutex_lock(&state_lock, K_FOREVER);
	if (state.has_probe && probe->sequence > state.last_probe.sequence + 1U) {
		state.sequence_gaps += probe->sequence - state.last_probe.sequence - 1U;
	}
	state.last_probe = *probe;
	state.has_probe = true;
	state.processed++;
	k_mutex_unlock(&state_lock);
}

void app_state_get(struct app_state_snapshot *snapshot)
{
	k_mutex_lock(&state_lock, K_FOREVER);
	*snapshot = state;
	k_mutex_unlock(&state_lock);
}

void app_state_set_connected(bool connected)
{
	k_mutex_lock(&state_lock, K_FOREVER);
	if (state.connected != connected) {
		state.connected = connected;
		if (connected) {
			state.connect_transitions++;
		} else {
			state.disconnect_transitions++;
		}
	}
	k_mutex_unlock(&state_lock);
}
```
