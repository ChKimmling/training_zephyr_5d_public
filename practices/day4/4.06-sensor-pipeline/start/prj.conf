## prj.conf
```kconfig
CONFIG_SENSOR=y
CONFIG_I2C=y
CONFIG_EMUL=y
CONFIG_BMI160_TRIGGER_NONE=y
CONFIG_LOG=y
CONFIG_LOG_DEFAULT_LEVEL=3
CONFIG_MAIN_STACK_SIZE=4096
```

## src/main.c
```c
#include <zephyr/kernel.h>
#include <zephyr/logging/log.h>
#include "app_state.h"
#include "motion_probe.h"
#include "probe_queue.h"
#include "sensor_source.h"

LOG_MODULE_REGISTER(motion_monitor, LOG_LEVEL_INF);

int main(void)
{
	const struct motion_axes stimulus = {0, 0, 9807};
	struct motion_axes axes = {0};
	struct motion_probe probe;
	struct app_state_snapshot state;
	int rc = sensor_source_init();

	probe_queue_reset();
	app_state_reset();
	if (rc == 0) {
		rc = sensor_source_set_sample(&stimulus);
	}
	if (rc == 0) {
		rc = sensor_source_read(&axes);
	}
	motion_probe_build(&probe, &axes, rc, 1U, k_uptime_get());
	rc = probe_queue_publish_latest(&probe);
	if (rc >= 0 && probe_queue_take(&probe, K_NO_WAIT) == 0) {
		app_state_accept_probe(&probe);
	}
	app_state_get(&state);
	LOG_INF("processed=%u drops=%u gaps=%u", state.processed,
		state.queue_drops, state.sequence_gaps);
	return 0;
}
```

## src/app_state.c
```c
#include "app_state.h"
#include <string.h>
#include <zephyr/kernel.h>

static K_MUTEX_DEFINE(state_lock);
static struct app_state_snapshot state;

void app_state_reset(void)
{
	k_mutex_lock(&state_lock, K_FOREVER);
	memset(&state, 0, sizeof(state));
	k_mutex_unlock(&state_lock);
}

void app_state_note_sensor_error(void)
{
	/* TODO(4.06-03): sensor_errors unter dem State-Lock genau einmal
	 * erhöhen. */
}

void app_state_note_queue_drop(void)
{
	/* Der Drop-Zähler gehört zum selben Zähler-Arbeitsauftrag. */
}

void app_state_accept_probe(const struct motion_probe *probe)
{
	k_mutex_lock(&state_lock, K_FOREVER);
	/* TODO(4.06-06): Vor dem Überschreiben eine Sequenzlücke erkennen und
	 * nur die tatsächlich fehlenden Sequenzen zählen. */
	/* TODO(4.06-05): Probe als konsistenten letzten Snapshot speichern,
	 * has_probe setzen und processed erhöhen. */
	ARG_UNUSED(probe);
	k_mutex_unlock(&state_lock);
}

void app_state_get(struct app_state_snapshot *snapshot)
{
	k_mutex_lock(&state_lock, K_FOREVER);
	*snapshot = state;
	k_mutex_unlock(&state_lock);
}
```

## src/probe_queue.c
```c
#include "probe_queue.h"
#include <errno.h>

K_MSGQ_DEFINE(motion_probe_queue, sizeof(struct motion_probe), PROBE_QUEUE_CAPACITY, 4);

void probe_queue_reset(void)
{
	k_msgq_purge(&motion_probe_queue);
}

int probe_queue_publish_latest(const struct motion_probe *probe)
{
	/* TODO(4.06-01): Die Probe mit K_NO_WAIT einstellen und Erfolg direkt
	 * zurückgeben. */
	/* TODO(4.06-02): Bei voller Queue den ältesten Eintrag entfernen, die
	 * neue Probe einstellen und einen Drop durch Rückgabewert 1 melden. */
	ARG_UNUSED(probe);
	return -EAGAIN;
}

int probe_queue_take(struct motion_probe *probe, k_timeout_t timeout)
{
	/* TODO(4.06-04): Eine vollständige Probe mit dem übergebenen Timeout
	 * aus der Queue entnehmen. */
	ARG_UNUSED(probe);
	ARG_UNUSED(timeout);
	return -ENOMSG;
}

uint32_t probe_queue_depth(void)
{
	return k_msgq_num_used_get(&motion_probe_queue);
}
```
