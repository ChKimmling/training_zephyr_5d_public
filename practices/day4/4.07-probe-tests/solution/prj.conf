## CMakeLists.txt
```
cmake_minimum_required(VERSION 3.20.0)
find_package(Zephyr REQUIRED HINTS $ENV{ZEPHYR_BASE})
project(day4_probe_tests)
target_include_directories(app PRIVATE include)
target_sources(app PRIVATE src/main.c src/motion_probe.c src/probe_queue.c src/app_state.c)
```

## prj.conf
```kconfig
CONFIG_ZTEST=y
CONFIG_MAIN_STACK_SIZE=4096
```

## src/main.c
```c
#include <errno.h>
#include <zephyr/ztest.h>
#include "app_state.h"
#include "motion_probe.h"
#include "probe_queue.h"

static void before_test(void *fixture)
{
	ARG_UNUSED(fixture);
	probe_queue_reset();
	app_state_reset();
}

ZTEST(probe, test_valid_and_range)
{
	struct motion_probe value;
	const struct motion_axes valid = {1000, -1000, 9807};
	const struct motion_axes invalid = {20001, 0, 0};

	motion_probe_build(&value, &valid, 0, 1, 10);
	zassert_equal(value.quality, MOTION_QUALITY_OK);
	zassert_equal(value.sequence, 1U);
	motion_probe_build(&value, &invalid, 0, 2, 20);
	zassert_equal(value.quality, MOTION_QUALITY_RANGE);
}

ZTEST(probe, test_sensor_error)
{
	struct motion_probe value;
	struct motion_axes ignored = {1, 2, 3};

	motion_probe_build(&value, &ignored, -EIO, 7, 100);
	zassert_equal(value.quality, MOTION_QUALITY_SENSOR_ERROR);
	zassert_equal(value.x_mm_s2, 0);
}

ZTEST(probe, test_queue_overload_keeps_latest)
{
	struct motion_probe value = { .quality = MOTION_QUALITY_OK };
	struct app_state_snapshot state;
	int drops = 0;

	for (uint32_t sequence = 1; sequence <= 6; ++sequence) {
		value.sequence = sequence;
		if (probe_queue_publish_latest(&value) == 1) {
			drops++;
			app_state_note_queue_drop();
		}
	}
	while (probe_queue_take(&value, K_NO_WAIT) == 0) {
		app_state_accept_probe(&value);
	}
	app_state_get(&state);
	zassert_equal(drops, 2);
	zassert_equal(state.queue_drops, 2U);
	zassert_equal(state.processed, 4U);
	zassert_equal(state.last_probe.sequence, 6U);
}

ZTEST(probe, test_sequence_gap)
{
	struct motion_probe value = { .quality = MOTION_QUALITY_OK };
	struct app_state_snapshot state;

	value.sequence = 1;
	app_state_accept_probe(&value);
	value.sequence = 4;
	app_state_accept_probe(&value);
	app_state_get(&state);
	zassert_equal(state.sequence_gaps, 2U);
}

ZTEST(probe, test_age_is_never_negative)
{
	const struct motion_probe value = { .captured_ms = 100 };
	zassert_equal(motion_probe_age_ms(&value, 90), 0);
	zassert_equal(motion_probe_age_ms(&value, 125), 25);
}

ZTEST_SUITE(probe, NULL, NULL, before_test, NULL, NULL);
```

## src/app_state.c
```c
#include "app_state.h"

#include <string.h>

#include <zephyr/kernel.h>

static K_MUTEX_DEFINE(state_lock);
static struct app_state_snapshot state;

void app_state_reset(void)
{
	k_mutex_lock(&state_lock, K_FOREVER);
	memset(&state, 0, sizeof(state));
	k_mutex_unlock(&state_lock);
}

void app_state_note_sensor_error(void)
{
	k_mutex_lock(&state_lock, K_FOREVER);
	state.sensor_errors++;
	k_mutex_unlock(&state_lock);
}

void app_state_note_queue_drop(void)
{
	k_mutex_lock(&state_lock, K_FOREVER);
	state.queue_drops++;
	k_mutex_unlock(&state_lock);
}

void app_state_accept_probe(const struct motion_probe *probe)
{
	k_mutex_lock(&state_lock, K_FOREVER);
	if (state.has_probe && probe->sequence > state.last_probe.sequence + 1U) {
		state.sequence_gaps += probe->sequence - state.last_probe.sequence - 1U;
	}
	state.last_probe = *probe;
	state.has_probe = true;
	state.processed++;
	k_mutex_unlock(&state_lock);
}

void app_state_get(struct app_state_snapshot *snapshot)
{
	k_mutex_lock(&state_lock, K_FOREVER);
	*snapshot = state;
	k_mutex_unlock(&state_lock);
}
```
