## prj.conf
```kconfig
CONFIG_LOG=y
CONFIG_LOG_MODE_IMMEDIATE=y
CONFIG_LOG_DEFAULT_LEVEL=3
CONFIG_LOG_MAX_LEVEL=4
CONFIG_MAIN_STACK_SIZE=2048

# TODO: enable the shell and its serial backend for the participant task.
# CONFIG_SHELL=y
# CONFIG_SHELL_BACKEND_SERIAL=y

# TODO: enable the device, kernel, and GPIO shell command groups.
# CONFIG_DEVICE_SHELL=y
# CONFIG_KERNEL_SHELL=y
# CONFIG_GPIO=y
# CONFIG_GPIO_SHELL=y
```

## src/main.c
```c
#include <zephyr/logging/log.h>

LOG_MODULE_REGISTER(day3_shell_setup, LOG_LEVEL_INF);

int main(void)
{
	/* Logging remains enabled from exercise 3.02; this app does not yet enable a shell. */
	LOG_INF("Day 3 shell setup application started");
	return 0;
}
```
