## CMakeLists.txt
```
cmake_minimum_required(VERSION 3.20.0)
find_package(Zephyr REQUIRED HINTS $ENV{ZEPHYR_BASE})
project(day3_zbus_contract)
target_include_directories(app PRIVATE include)
target_sources(app PRIVATE src/main.c src/event_channels.c)
```

## prj.conf
```kconfig
CONFIG_LOG=y
CONFIG_LOG_MODE_IMMEDIATE=y
CONFIG_LOG_DEFAULT_LEVEL=3
CONFIG_ZBUS=y
CONFIG_MAIN_STACK_SIZE=2048
```

## src/main.c
```c
#include <zephyr/logging/log.h>

#include "event_channels.h"

LOG_MODULE_REGISTER(day3_zbus_contract, LOG_LEVEL_INF);

int main(void)
{
	LOG_INF("zbus contract ready: event_cmd_chan and event_input_chan");
	return 0;
}
```

## src/event_channels.c
```c
#include "event_channels.h"

ZBUS_CHAN_DEFINE(event_cmd_chan, struct event_command, NULL, NULL,
		 ZBUS_OBSERVERS_EMPTY, ZBUS_MSG_INIT(.type = EVENT_CMD_START));
		 
ZBUS_CHAN_DEFINE(event_input_chan, struct event_input, NULL, NULL,
		 ZBUS_OBSERVERS_EMPTY, ZBUS_MSG_INIT(.source = EVENT_SOURCE_SHELL));
```
