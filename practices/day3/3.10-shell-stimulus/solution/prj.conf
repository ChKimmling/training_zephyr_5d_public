## CMakeLists.txt
```
cmake_minimum_required(VERSION 3.20.0)
find_package(Zephyr REQUIRED HINTS $ENV{ZEPHYR_BASE})
project(day3_shell_stimulus)
target_include_directories(app PRIVATE include)
target_sources(app PRIVATE src/main.c src/event_service.c src/stimulus.c src/event_shell.c)
```

## prj.conf
```kconfig
CONFIG_PRINTK=y
CONFIG_LOG=y
CONFIG_LOG_MODE_IMMEDIATE=y
CONFIG_LOG_DEFAULT_LEVEL=3
CONFIG_LOG_MAX_LEVEL=4
CONFIG_GPIO=y
CONFIG_SHELL=y
CONFIG_SHELL_BACKEND_SERIAL=y
CONFIG_MAIN_STACK_SIZE=2048
CONFIG_SYSTEM_WORKQUEUE_STACK_SIZE=2048
CONFIG_ZBUS=y
CONFIG_ZBUS_MSG_SUBSCRIBER=y
CONFIG_ZBUS_ASYNC_LISTENER=y
CONFIG_HEAP_MEM_POOL_SIZE=1024
CONFIG_ZBUS_MSG_SUBSCRIBER_NET_BUF_POOL_SIZE=32
```

## src/main.c
```c
#include <errno.h>
#include <zephyr/drivers/gpio.h>
#include <zephyr/kernel.h>
#include <zephyr/logging/log.h>

#include "event_channels.h"
#include "event_service.h"
#include "stimulus.h"

LOG_MODULE_REGISTER(day3_shell_stimulus, LOG_LEVEL_INF);

static const struct gpio_dt_spec input =
	GPIO_DT_SPEC_GET(DT_ALIAS(event_input), gpios);
static struct gpio_callback input_callback;
static uint32_t input_sequence;

static void input_changed(const struct device *port, struct gpio_callback *callback,
			  gpio_port_pins_t pins)
{
	ARG_UNUSED(port);
	ARG_UNUSED(callback);
	if ((pins & BIT(input.pin)) != 0U) {
		int active = gpio_pin_get_dt(&input);

		if (active <= 0) {
			return;
		}
		struct event_input event = {
			.source = EVENT_SOURCE_EMULATED,
			.sequence = ++input_sequence,
			.active = true,
			.timestamp = k_uptime_get(),
		};
		int ret = zbus_chan_pub(&event_input_chan, &event, K_NO_WAIT);

		if (ret == 0) {
			event_service_record_input_published();
		} else {
			event_service_record_publish_failure(ret);
			LOG_ERR("input publish failed: %d", ret);
		}
	}
}

int main(void)
{
	int ret = event_service_init();

	if (ret != 0) {
		LOG_ERR("Event service initialization failed: %d", ret);
		return ret;
	}
	if (!gpio_is_ready_dt(&input)) {
		LOG_ERR("Event input device is not ready");
		return -ENODEV;
	}
	ret = gpio_pin_configure_dt(&input, GPIO_INPUT);
	if (ret != 0) {
		LOG_ERR("Cannot configure event input: %d", ret);
		return ret;
	}
	gpio_init_callback(&input_callback, input_changed, BIT(input.pin));
	ret = gpio_add_callback(input.port, &input_callback);
	if (ret != 0) {
		LOG_ERR("Cannot add GPIO callback: %d", ret);
		return ret;
	}
	ret = stimulus_init(&input);
	if (ret != 0) {
		LOG_ERR("Cannot initialize stimulus: %d", ret);
		return ret;
	}
	ret = gpio_pin_interrupt_configure_dt(&input, GPIO_INT_EDGE_BOTH);
	if (ret != 0) {
		LOG_ERR("Cannot enable GPIO edges: %d", ret);
		return ret;
	}
	LOG_INF("Try: event status, event stats, event input 1, event pulse, event burst 3 200");
	return 0;
}
```

## include/event_messages.h
```c
#ifndef EVENT_MESSAGES_H
#define EVENT_MESSAGES_H

#include <stdbool.h>
#include <stdint.h>

enum event_command_type {
	EVENT_CMD_START,
	EVENT_CMD_STOP,
	EVENT_CMD_RESET,
	EVENT_CMD_INPUT,
	EVENT_CMD_PULSE,
	EVENT_CMD_BURST,
	EVENT_CMD_CANCEL,
};

struct event_command {
	enum event_command_type type;
	uint32_t sequence;
	int32_t value;
	uint32_t count;
	uint32_t duration_ms;
	uint32_t interval_ms;
};

enum event_input_source {
	EVENT_SOURCE_SHELL,
	EVENT_SOURCE_EMULATED,
	EVENT_SOURCE_GPIO,
};

struct event_input {
	enum event_input_source source;
	uint32_t sequence;
	bool active;
	int64_t timestamp;
};

#endif
```

## include/event_service.h
```c
#ifndef EVENT_SERVICE_H
#define EVENT_SERVICE_H

#include <stdint.h>

struct event_stats {
	uint32_t cmd_published;
	uint32_t cmd_received;
	uint32_t cmd_rejected;
	uint32_t input_published;
	uint32_t input_received;
	uint32_t processed;
	uint32_t publish_failed;
	int32_t last_error;
};

int event_service_init(void);
void event_service_record_command_published(void);
void event_service_record_command_received(void);
void event_service_reject(int error);
void event_service_record_input_published(void);
void event_service_record_input_received(void);
void event_service_record_publish_failure(int error);
int event_service_get_stats(struct event_stats *stats);
int event_service_reset_stats(void);

#endif
```

## include/stimulus.h
```c
#ifndef STIMULUS_H
#define STIMULUS_H

#include <stdbool.h>
#include <stdint.h>
#include <zephyr/drivers/gpio.h>

struct stimulus_status {
	bool input_active;
	const char *mode;
	uint32_t remaining;
	int last_error;
};

int stimulus_init(const struct gpio_dt_spec *input);
int stimulus_set_input(bool active);
int stimulus_start_pulse(uint32_t duration_ms);
int stimulus_start_burst(uint32_t count, uint32_t gap_ms);
int stimulus_cancel(void);
void stimulus_get_status(struct stimulus_status *status);

#endif
```

## src/event_channels.c
```c
#include "event_channels.h"

ZBUS_CHAN_DEFINE(event_cmd_chan, struct event_command, NULL, NULL,
		 ZBUS_OBSERVERS(event_stimulus_subscriber),
		 ZBUS_MSG_INIT(.type = EVENT_CMD_RESET));
ZBUS_CHAN_DEFINE(event_input_chan, struct event_input, NULL, NULL,
		 ZBUS_OBSERVERS(event_input_listener),
		 ZBUS_MSG_INIT(.source = EVENT_SOURCE_EMULATED));
```

## src/event_input_listener.c
```c
#include <zephyr/logging/log.h>

#include "event_channels.h"
#include "event_service.h"

LOG_MODULE_REGISTER(event_input_listener, LOG_LEVEL_INF);

static void input_callback(const struct zbus_channel *chan, const void *message)
{
	const struct event_input *input = message;

	if (chan != &event_input_chan || input == NULL) {
		LOG_ERR("invalid input event");
		return;
	}
	event_service_record_input_received();
	LOG_DBG("input sequence=%u active=%d", input->sequence, input->active);
}

ZBUS_ASYNC_LISTENER_DEFINE(event_input_listener, input_callback);
```

## src/event_service.c
```c
#include <errno.h>
#include <zephyr/kernel.h>
#include <zephyr/sys/atomic.h>

#include "event_service.h"

static atomic_t cmd_published;
static atomic_t cmd_received;
static atomic_t cmd_rejected;
static atomic_t input_published;
static atomic_t input_received;
static atomic_t processed;
static atomic_t publish_failed;
static atomic_t last_error;
K_SEM_DEFINE(event_pending, 0, UINT_MAX);

static void event_worker(void *p1, void *p2, void *p3)
{
	ARG_UNUSED(p1);
	ARG_UNUSED(p2);
	ARG_UNUSED(p3);
	while (true) {
		k_sem_take(&event_pending, K_FOREVER);
		atomic_inc(&processed);
	}
}

K_THREAD_DEFINE(event_worker_thread, 1024, event_worker, NULL, NULL, NULL,
		K_PRIO_PREEMPT(3), 0, 0);

int event_service_init(void)
{
	atomic_set(&cmd_published, 0);
	atomic_set(&cmd_received, 0);
	atomic_set(&cmd_rejected, 0);
	atomic_set(&input_published, 0);
	atomic_set(&input_received, 0);
	atomic_set(&processed, 0);
	atomic_set(&publish_failed, 0);
	atomic_set(&last_error, 0);
	return 0;
}

void event_service_record_command_published(void) { atomic_inc(&cmd_published); }
void event_service_record_command_received(void) { atomic_inc(&cmd_received); }

void event_service_reject(int error)
{
	atomic_inc(&cmd_rejected);
	atomic_set(&last_error, error);
}

void event_service_record_input_published(void) { atomic_inc(&input_published); }

void event_service_record_input_received(void)
{
	atomic_inc(&input_received);
	k_sem_give(&event_pending);
}

void event_service_record_publish_failure(int error)
{
	atomic_inc(&publish_failed);
	atomic_set(&last_error, error);
}

int event_service_get_stats(struct event_stats *stats)
{
	if (stats == NULL) {
		return -EINVAL;
	}
	stats->cmd_published = (uint32_t)atomic_get(&cmd_published);
	stats->cmd_received = (uint32_t)atomic_get(&cmd_received);
	stats->cmd_rejected = (uint32_t)atomic_get(&cmd_rejected);
	stats->input_published = (uint32_t)atomic_get(&input_published);
	stats->input_received = (uint32_t)atomic_get(&input_received);
	stats->processed = (uint32_t)atomic_get(&processed);
	stats->publish_failed = (uint32_t)atomic_get(&publish_failed);
	stats->last_error = (int32_t)atomic_get(&last_error);
	return 0;
}

int event_service_reset_stats(void)
{
	atomic_set(&cmd_published, 0);
	atomic_set(&cmd_received, 0);
	atomic_set(&cmd_rejected, 0);
	atomic_set(&input_published, 0);
	atomic_set(&input_received, 0);
	atomic_set(&processed, 0);
	atomic_set(&publish_failed, 0);
	atomic_set(&last_error, 0);
	return 0;
}
```

## src/event_shell.c
```c
#include <errno.h>
#include <stdlib.h>
#include <zephyr/shell/shell.h>

#include "event_channels.h"
#include "event_service.h"
#include "stimulus.h"

static uint32_t command_sequence;

static int parse_u32(const struct shell *sh, const char *text, uint32_t min,
		     uint32_t max, uint32_t *value)
{
	char *end;
	unsigned long parsed;

	if (text == NULL || text[0] == '\0') {
		event_service_reject(-EINVAL);
		shell_error(sh, "expected an unsigned integer");
		return -EINVAL;
	}
	for (const char *digit = text; *digit != '\0'; digit++) {
		if (*digit < '0' || *digit > '9') {
			event_service_reject(-EINVAL);
			shell_error(sh, "expected an unsigned integer");
			return -EINVAL;
		}
	}
	errno = 0;
	parsed = strtoul(text, &end, 10);
	if (errno != 0 || end == text || *end != '\0' || parsed < min || parsed > max) {
		event_service_reject(-ERANGE);
		shell_error(sh, "value must be in range %u..%u", min, max);
		return -ERANGE;
	}
	*value = (uint32_t)parsed;
	return 0;
}

static int publish_command(const struct shell *sh, struct event_command *command)
{
	command->sequence = ++command_sequence;
	int ret = zbus_chan_pub(&event_cmd_chan, command, K_NO_WAIT);

	if (ret != 0) {
		event_service_record_publish_failure(ret);
		shell_error(sh, "command publish failed: %d", ret);
		return ret;
	}
	event_service_record_command_published();
	shell_print(sh, "command sequence=%u published", command->sequence);
	return 0;
}

static int cmd_status(const struct shell *sh, size_t argc, char **argv)
{
	struct stimulus_status status;

	ARG_UNUSED(argc);
	ARG_UNUSED(argv);
	stimulus_get_status(&status);
	shell_print(sh, "input=%s stimulus=%s remaining=%u last_error=%d",
		    status.input_active ? "active" : "idle", status.mode,
		    status.remaining, status.last_error);
	return 0;
}

static int cmd_stats(const struct shell *sh, size_t argc, char **argv)
{
	struct event_stats stats;
	int ret;

	ARG_UNUSED(argc);
	ARG_UNUSED(argv);
	ret = event_service_get_stats(&stats);
	if (ret != 0) {
		shell_error(sh, "stats unavailable: %d", ret);
		return ret;
	}
	shell_print(sh, "cmd_published=%u cmd_received=%u cmd_rejected=%u input_published=%u input_received=%u processed=%u publish_failed=%u last_error=%d",
		    stats.cmd_published, stats.cmd_received, stats.cmd_rejected,
		    stats.input_published, stats.input_received, stats.processed,
		    stats.publish_failed, stats.last_error);
	return 0;
}

static int cmd_reset(const struct shell *sh, size_t argc, char **argv)
{
	struct event_command command = {.type = EVENT_CMD_RESET};

	ARG_UNUSED(argc);
	ARG_UNUSED(argv);
	return publish_command(sh, &command);
}

static int cmd_input(const struct shell *sh, size_t argc, char **argv)
{
	struct event_command command = {.type = EVENT_CMD_INPUT};
	uint32_t value;
	int ret;

	ARG_UNUSED(argc);
	ret = parse_u32(sh, argv[1], 0U, 1U, &value);
	if (ret != 0) {
		return ret;
	}
	command.value = (int32_t)value;
	return publish_command(sh, &command);
}

static int cmd_pulse(const struct shell *sh, size_t argc, char **argv)
{
	struct event_command command = {
		.type = EVENT_CMD_PULSE,
		.duration_ms = 100U,
	};
	int ret = 0;

	if (argc > 1U) {
		ret = parse_u32(sh, argv[1], 20U, 2000U, &command.duration_ms);
	}
	return ret != 0 ? ret : publish_command(sh, &command);
}

static int cmd_burst(const struct shell *sh, size_t argc, char **argv)
{
	struct event_command command = {.type = EVENT_CMD_BURST};
	int ret;

	ARG_UNUSED(argc);
	ret = parse_u32(sh, argv[1], 1U, 20U, &command.count);
	if (ret == 0) {
		ret = parse_u32(sh, argv[2], 20U, 2000U, &command.interval_ms);
	}
	return ret != 0 ? ret : publish_command(sh, &command);
}

static int cmd_cancel(const struct shell *sh, size_t argc, char **argv)
{
	struct event_command command = {.type = EVENT_CMD_CANCEL};

	ARG_UNUSED(argc);
	ARG_UNUSED(argv);
	return publish_command(sh, &command);
}

SHELL_STATIC_SUBCMD_SET_CREATE(event_commands,
	SHELL_CMD_ARG(status, NULL, "Show event and stimulus status", cmd_status, 1, 0),
	SHELL_CMD_ARG(stats, NULL, "Show input event counters", cmd_stats, 1, 0),
	SHELL_CMD_ARG(reset, NULL, "Publish statistics reset", cmd_reset, 1, 0),
	SHELL_CMD_ARG(input, NULL, "Set emulated input: 0 or 1", cmd_input, 2, 0),
	SHELL_CMD_ARG(pulse, NULL, "Generate pulse: optional duration_ms", cmd_pulse, 1, 2),
	SHELL_CMD_ARG(burst, NULL, "Generate pulses: count and gap_ms", cmd_burst, 3, 0),
	SHELL_CMD_ARG(cancel, NULL, "Cancel active stimulus", cmd_cancel, 1, 0),
	SHELL_SUBCMD_SET_END
);
SHELL_CMD_REGISTER(event, &event_commands, "Event stimulus command publisher", NULL);
```

## src/stimulus.c
```c
#include <errno.h>
#include <zephyr/drivers/gpio/gpio_emul.h>
#include <zephyr/kernel.h>

#include "stimulus.h"

#define PULSE_WIDTH_MS 100U
#define PULSE_MIN_MS 20U
#define PULSE_MAX_MS 2000U
#define BURST_MAX_COUNT 20U
#define GAP_MIN_MS 20U
#define GAP_MAX_MS 2000U

enum sequence_mode {
	SEQUENCE_IDLE,
	SEQUENCE_PULSE,
	SEQUENCE_BURST,
};

static struct gpio_dt_spec input;
K_MUTEX_DEFINE(stimulus_mutex);
static struct k_work_delayable sequence_work;
static enum sequence_mode mode;
static bool input_active;
static bool phase_active;
static uint32_t remaining;
static uint32_t pulse_duration_ms;
static uint32_t gap_ms;
static int last_error;

static int set_level_locked(bool active)
{
	int ret = gpio_emul_input_set_dt(&input, active ? 1 : 0);

	if (ret == 0) {
		input_active = active;
		last_error = 0;
	} else {
		last_error = ret;
	}
	return ret;
}

static void sequence_handler(struct k_work *work)
{
	int ret = 0;

	ARG_UNUSED(work);
	k_mutex_lock(&stimulus_mutex, K_FOREVER);

	if (mode == SEQUENCE_IDLE) {
		k_mutex_unlock(&stimulus_mutex);
		return;
	}

	if (phase_active) {
		ret = set_level_locked(false);
		phase_active = false;
		if (mode == SEQUENCE_PULSE || remaining <= 1U) {
			mode = SEQUENCE_IDLE;
			remaining = 0U;
		} else {
			remaining--;
			k_work_reschedule(&sequence_work, K_MSEC(gap_ms));
		}
	} else {
		ret = set_level_locked(true);
		if (ret == 0) {
			phase_active = true;
			k_work_reschedule(&sequence_work, K_MSEC(PULSE_WIDTH_MS));
		}
	}

	if (ret != 0) {
		set_level_locked(false);
		mode = SEQUENCE_IDLE;
		remaining = 0U;
		phase_active = false;
	}
	k_mutex_unlock(&stimulus_mutex);
}

int stimulus_init(const struct gpio_dt_spec *gpio)
{
	if (gpio == NULL || !gpio_is_ready_dt(gpio)) {
		return -ENODEV;
	}
	input = *gpio;
	k_work_init_delayable(&sequence_work, sequence_handler);
	k_mutex_lock(&stimulus_mutex, K_FOREVER);
	mode = SEQUENCE_IDLE;
	input_active = false;
	remaining = 0U;
	last_error = 0;
	int ret = set_level_locked(false);
	k_mutex_unlock(&stimulus_mutex);
	return ret;
}

int stimulus_set_input(bool active)
{
	k_mutex_lock(&stimulus_mutex, K_FOREVER);
	if (mode != SEQUENCE_IDLE) {
		k_mutex_unlock(&stimulus_mutex);
		return -EBUSY;
	}
	int ret = set_level_locked(active);
	k_mutex_unlock(&stimulus_mutex);
	return ret;
}

int stimulus_start_pulse(uint32_t duration_ms)
{
	if (duration_ms < PULSE_MIN_MS || duration_ms > PULSE_MAX_MS) {
		return -ERANGE;
	}
	k_mutex_lock(&stimulus_mutex, K_FOREVER);
	if (mode != SEQUENCE_IDLE) {
		k_mutex_unlock(&stimulus_mutex);
		return -EBUSY;
	}
	mode = SEQUENCE_PULSE;
	remaining = 1U;
	pulse_duration_ms = duration_ms;
	int ret = set_level_locked(false);
	if (ret == 0) {
		ret = set_level_locked(true);
	}
	if (ret == 0) {
		phase_active = true;
		k_work_reschedule(&sequence_work, K_MSEC(pulse_duration_ms));
	} else {
		mode = SEQUENCE_IDLE;
		remaining = 0U;
	}
	k_mutex_unlock(&stimulus_mutex);
	return ret;
}

int stimulus_start_burst(uint32_t count, uint32_t gap)
{
	if (count == 0U || count > BURST_MAX_COUNT || gap < GAP_MIN_MS ||
	    gap > GAP_MAX_MS) {
		return -ERANGE;
	}
	k_mutex_lock(&stimulus_mutex, K_FOREVER);
	if (mode != SEQUENCE_IDLE) {
		k_mutex_unlock(&stimulus_mutex);
		return -EBUSY;
	}
	mode = SEQUENCE_BURST;
	remaining = count;
	gap_ms = gap;
	int ret = set_level_locked(false);
	if (ret == 0) {
		ret = set_level_locked(true);
	}
	if (ret == 0) {
		phase_active = true;
		k_work_reschedule(&sequence_work, K_MSEC(PULSE_WIDTH_MS));
	} else {
		mode = SEQUENCE_IDLE;
		remaining = 0U;
	}
	k_mutex_unlock(&stimulus_mutex);
	return ret;
}

int stimulus_cancel(void)
{
	k_work_cancel_delayable(&sequence_work);
	k_mutex_lock(&stimulus_mutex, K_FOREVER);
	int ret = set_level_locked(false);
	mode = SEQUENCE_IDLE;
	remaining = 0U;
	phase_active = false;
	k_mutex_unlock(&stimulus_mutex);
	return ret;
}

void stimulus_get_status(struct stimulus_status *status)
{
	if (status == NULL) {
		return;
	}
	k_mutex_lock(&stimulus_mutex, K_FOREVER);
	status->input_active = input_active;
	status->remaining = remaining;
	status->last_error = last_error;
	status->mode = mode == SEQUENCE_PULSE ? "pulse" :
		       mode == SEQUENCE_BURST ? "burst" : "idle";
	k_mutex_unlock(&stimulus_mutex);
}
```

## src/stimulus_subscriber.c
```c
#include <errno.h>
#include <zephyr/kernel.h>
#include <zephyr/logging/log.h>

#include "event_channels.h"
#include "event_service.h"
#include "stimulus.h"

LOG_MODULE_REGISTER(stimulus_subscriber, LOG_LEVEL_INF);

ZBUS_MSG_SUBSCRIBER_DEFINE(event_stimulus_subscriber);

static void subscriber_thread(void *p1, void *p2, void *p3)
{
	const struct zbus_channel *chan;
	struct event_command command;

	ARG_UNUSED(p1);
	ARG_UNUSED(p2);
	ARG_UNUSED(p3);
	while (zbus_sub_wait_msg(&event_stimulus_subscriber, &chan, &command, K_FOREVER) == 0) {
		int ret = 0;

		if (chan != &event_cmd_chan) {
			event_service_reject(-EINVAL);
			LOG_ERR("unexpected zbus channel");
			continue;
		}
		event_service_record_command_received();
		switch (command.type) {
		case EVENT_CMD_RESET:
			ret = event_service_reset_stats();
			break;
		case EVENT_CMD_INPUT:
			ret = stimulus_set_input(command.value != 0);
			break;
		case EVENT_CMD_PULSE:
			ret = stimulus_start_pulse(command.duration_ms);
			break;
		case EVENT_CMD_BURST:
			ret = stimulus_start_burst(command.count, command.interval_ms);
			break;
		case EVENT_CMD_CANCEL:
			ret = stimulus_cancel();
			break;
		default:
			ret = -EINVAL;
			break;
		}
		if (ret != 0) {
			event_service_reject(ret);
			LOG_WRN("stimulus command rejected: %d", ret);
		}
	}
}

K_THREAD_DEFINE(event_stimulus_subscriber_thread, 1536, subscriber_thread,
		NULL, NULL, NULL, K_PRIO_PREEMPT(3), 0, 0);
```
