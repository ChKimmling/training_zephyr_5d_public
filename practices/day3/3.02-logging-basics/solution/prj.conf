## CMakeLists.txt
```
cmake_minimum_required(VERSION 3.20.0)
find_package(Zephyr REQUIRED HINTS $ENV{ZEPHYR_BASE})
project(day3_logging_basics)

target_sources(app PRIVATE src/main.c)
```

## Kconfig
```
mainmenu "Day 3 logging basics"

source "Kconfig.zephyr"

config EVENT_APP_LOG_LEVEL
	int "Event application log level"
	range 0 4
	default 3
	help
	  Compile-time log level for the event_app module: 3 for info and 4 for debug.
```

## prj.conf
```kconfig
CONFIG_LOG=y
CONFIG_LOG_MODE_IMMEDIATE=y
CONFIG_LOG_DEFAULT_LEVEL=3
CONFIG_LOG_MAX_LEVEL=4
CONFIG_EVENT_APP_LOG_LEVEL=3
CONFIG_MAIN_STACK_SIZE=2048
```

## logging-debug.conf
```kconfig
CONFIG_EVENT_APP_LOG_LEVEL=4
```

## src/main.c
```c
#include <errno.h>
#include <zephyr/kernel.h>
#include <zephyr/logging/log.h>

LOG_MODULE_REGISTER(event_app, CONFIG_EVENT_APP_LOG_LEVEL);

int main(void)
{
	LOG_INF("Event Service started");
	LOG_DBG("Input state initialized: active=%d", 0);
	LOG_WRN("Optional status output is not configured; continuing");
	LOG_ERR("Example error path: invalid event request rejected (%d)", -EINVAL);

	return 0;
}
```
