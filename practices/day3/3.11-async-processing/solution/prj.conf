## prj.conf
```kconfig
CONFIG_LOG=y
CONFIG_LOG_MODE_IMMEDIATE=y
CONFIG_ZBUS=y
CONFIG_ZBUS_ASYNC_LISTENER=y
CONFIG_MAIN_STACK_SIZE=2048
```

## include/event_channel.h
```c
#ifndef EVENT_CHANNEL_H
#define EVENT_CHANNEL_H

#include <zephyr/zbus/zbus.h>

#include "event_input.h"

ZBUS_CHAN_DECLARE(event_input_chan);
ZBUS_OBS_DECLARE(event_input_listener);

#endif
```

## src/event_channel.c
```c
#include "event_channel.h"

ZBUS_CHAN_DEFINE(event_input_chan, struct event_input, NULL, NULL,
		 ZBUS_OBSERVERS(event_input_listener),
		 ZBUS_MSG_INIT(.source = EVENT_SOURCE_EMULATED));
```

## src/event_listener.c
```c
#include <zephyr/kernel.h>
#include <zephyr/logging/log.h>

#include "event_channel.h"

LOG_MODULE_REGISTER(event_listener, LOG_LEVEL_INF);

static atomic_t input_received;
static atomic_t processed;

static void input_callback(const struct zbus_channel *chan, const void *message)
{
	const struct event_input *input = message;

	if (chan != &event_input_chan || input == NULL) {
		LOG_ERR("invalid input notification");
		return;
	}
	atomic_inc(&input_received);
	LOG_INF("processing sequence=%u source=%d active=%d",
		input->sequence, input->source, input->active);
	atomic_inc(&processed);
	LOG_INF("input_received=%d processed=%d",
		atomic_get(&input_received), atomic_get(&processed));
}

ZBUS_ASYNC_LISTENER_DEFINE(event_input_listener, input_callback);
```
