## CMakeLists.txt
```
cmake_minimum_required(VERSION 3.20.0)
find_package(Zephyr REQUIRED HINTS $ENV{ZEPHYR_BASE})
project(day3_event_shell)
target_include_directories(app PRIVATE include)
target_sources(app PRIVATE src/main.c src/event_service.c src/event_shell.c)
```

## prj.conf
```kconfig
CONFIG_PRINTK=y
CONFIG_LOG=y
CONFIG_LOG_MODE_IMMEDIATE=y
CONFIG_LOG_DEFAULT_LEVEL=3
CONFIG_LOG_MAX_LEVEL=4
CONFIG_SHELL=y
CONFIG_SHELL_BACKEND_SERIAL=y
CONFIG_MAIN_STACK_SIZE=2048
CONFIG_SHELL_CMD_BUFF_SIZE=256
CONFIG_ZBUS=y
CONFIG_ZBUS_MSG_SUBSCRIBER=y
CONFIG_HEAP_MEM_POOL_SIZE=1024
CONFIG_ZBUS_MSG_SUBSCRIBER_NET_BUF_POOL_SIZE=32
CONFIG_HEAP_MEM_POOL_SIZE=2048
```

## src/main.c
```c
#include <zephyr/kernel.h>
#include <zephyr/sys/printk.h>

#include "event_service.h"

int main(void)
{
	int ret = event_service_init();

	if (ret != 0) {
		printk("event service init failed: %d\n", ret);
		return ret;
	}
	printk("Event shell ready. Try: event status, event stats, event reset\n");
	return 0;
}
```

## include/event_service.h
```c
#ifndef EVENT_SERVICE_H
#define EVENT_SERVICE_H

#include <stdbool.h>
#include <stdint.h>

struct event_status {
	bool initialized;
	bool running;
	int last_error;
};

struct event_stats {
	uint32_t cmd_published;
	uint32_t cmd_received;
	uint32_t cmd_rejected;
	uint32_t input_published;
	uint32_t input_received;
	uint32_t processed;
	uint32_t publish_failed;
	int32_t last_error;
};

int event_service_init(void);
void event_service_set_running(bool running);
void event_service_record_published(void);
void event_service_record_received(void);
void event_service_record_rejected(void);
uint32_t event_service_next_sequence(void);
int event_service_get_status(struct event_status *status);
int event_service_get_stats(struct event_stats *stats);
int event_service_reset_stats(void);

#endif
```

## src/event_channels.c
```c
#include "event_channels.h"

ZBUS_CHAN_DEFINE(event_cmd_chan, struct event_command, NULL, NULL,
		 ZBUS_OBSERVERS(event_command_subscriber),
		 ZBUS_MSG_INIT(.type = EVENT_CMD_START));
```

## src/event_service.c
```c
#include <errno.h>
#include <zephyr/kernel.h>

#include "event_service.h"

K_MUTEX_DEFINE(service_mutex);
static struct event_stats counters;
static bool initialized;
static bool running;
static int last_error;
static uint32_t sequence_number;

int event_service_init(void)
{
	k_mutex_lock(&service_mutex, K_FOREVER);
	counters = (struct event_stats){0};
	running = false;
	last_error = 0;
	sequence_number = 0U;
	initialized = true;
	k_mutex_unlock(&service_mutex);
	return 0;
}

void event_service_set_running(bool active)
{
	k_mutex_lock(&service_mutex, K_FOREVER);
	running = active;
	last_error = 0;
	k_mutex_unlock(&service_mutex);
}

void event_service_record_published(void)
{
	k_mutex_lock(&service_mutex, K_FOREVER);
	counters.cmd_published++;
	k_mutex_unlock(&service_mutex);
}

void event_service_record_received(void)
{
	k_mutex_lock(&service_mutex, K_FOREVER);
	counters.cmd_received++;
	k_mutex_unlock(&service_mutex);
}

void event_service_record_rejected(void)
{
	k_mutex_lock(&service_mutex, K_FOREVER);
	counters.cmd_rejected++;
	last_error = -EINVAL;
	k_mutex_unlock(&service_mutex);
}

uint32_t event_service_next_sequence(void)
{
	k_mutex_lock(&service_mutex, K_FOREVER);
	uint32_t next = ++sequence_number;
	k_mutex_unlock(&service_mutex);
	return next;
}

int event_service_get_status(struct event_status *status)
{
	bool ready;

	if (status == NULL) {
		return -EINVAL;
	}
	k_mutex_lock(&service_mutex, K_FOREVER);
	ready = initialized;
	*status = (struct event_status) {
		.initialized = initialized,
		.running = running,
		.last_error = last_error,
	};
	k_mutex_unlock(&service_mutex);
	return ready ? 0 : -EAGAIN;
}

int event_service_get_stats(struct event_stats *stats)
{
	bool ready;

	if (stats == NULL) {
		return -EINVAL;
	}
	k_mutex_lock(&service_mutex, K_FOREVER);
	ready = initialized;
	*stats = counters;
	k_mutex_unlock(&service_mutex);
	return ready ? 0 : -EAGAIN;
}

int event_service_reset_stats(void)
{
	k_mutex_lock(&service_mutex, K_FOREVER);
	if (!initialized) {
		k_mutex_unlock(&service_mutex);
		return -EAGAIN;
	}
	counters = (struct event_stats){0};
	last_error = 0;
	k_mutex_unlock(&service_mutex);
	return 0;
}
```

## src/event_shell.c
```c
#include <errno.h>
#include <zephyr/shell/shell.h>

#include "event_service.h"

static int report_service_error(const struct shell *sh, const char *operation, int ret)
{
	if (ret == -EAGAIN) {
		shell_error(sh, "%s unavailable: event service is not initialized", operation);
	} else {
		shell_error(sh, "%s failed: %d", operation, ret);
	}
	return ret;
}

static int cmd_status(const struct shell *sh, size_t argc, char **argv)
{
	struct event_status status;
	int ret = event_service_get_status(&status);

	ARG_UNUSED(argc);
	ARG_UNUSED(argv);
	if (ret != 0) {
		return report_service_error(sh, "status", ret);
	}
	shell_print(sh, "initialized=%s input_ready=%s input=%s stimulus=%s error=%d",
		    status.initialized ? "yes" : "no",
		    status.input_ready ? "yes" : "no",
		    status.input_active ? "active" : "idle",
		    status.stimulus_state, status.last_error);
	return 0;
}

static int cmd_stats(const struct shell *sh, size_t argc, char **argv)
{
	struct event_stats stats;
	int ret = event_service_get_stats(&stats);

	ARG_UNUSED(argc);
	ARG_UNUSED(argv);
	if (ret != 0) {
		return report_service_error(sh, "stats", ret);
	}
	shell_print(sh, "raw=%u processed=%u rejected=%u", stats.raw_count,
		    stats.processed_count, stats.rejected_count);
	return 0;
}

static int cmd_reset(const struct shell *sh, size_t argc, char **argv)
{
	int ret = event_service_reset_stats();

	ARG_UNUSED(argc);
	ARG_UNUSED(argv);
	if (ret != 0) {
		return report_service_error(sh, "reset", ret);
	}
	shell_print(sh, "statistics reset");
	return 0;
}

SHELL_STATIC_SUBCMD_SET_CREATE(event_commands,
	SHELL_CMD_ARG(status, NULL, "Show event service status", cmd_status, 1, 0),
	SHELL_CMD_ARG(stats, NULL, "Show event statistics", cmd_stats, 1, 0),
	SHELL_CMD_ARG(reset, NULL, "Reset event statistics", cmd_reset, 1, 0),
	SHELL_SUBCMD_SET_END
);
SHELL_CMD_REGISTER(event, &event_commands, "Event service commands", NULL);
```

## src/event_subscriber.c
```c
#include <zephyr/kernel.h>
#include <zephyr/logging/log.h>

#include "event_channels.h"
#include "event_service.h"

LOG_MODULE_REGISTER(event_subscriber, LOG_LEVEL_INF);

ZBUS_MSG_SUBSCRIBER_DEFINE(event_command_subscriber);

static void subscriber_thread(void *p1, void *p2, void *p3)
{
	const struct zbus_channel *chan;
	struct event_command command;

	ARG_UNUSED(p1);
	ARG_UNUSED(p2);
	ARG_UNUSED(p3);
	while (zbus_sub_wait_msg(&event_command_subscriber, &chan, &command, K_FOREVER) == 0) {
		if (chan != &event_cmd_chan) {
			event_service_record_rejected();
			continue;
		}
		event_service_record_received();
		switch (command.type) {
		case EVENT_CMD_START:
			event_service_set_running(true);
			break;
		case EVENT_CMD_STOP:
			event_service_set_running(false);
			break;
		case EVENT_CMD_RESET:
			event_service_reset_stats();
			break;
		default:
			event_service_record_rejected();
			break;
		}
		LOG_DBG("command type=%d sequence=%u", command.type, command.sequence);
	}
}

K_THREAD_DEFINE(event_command_subscriber_thread, 1536, subscriber_thread,
		NULL, NULL, NULL, K_PRIO_PREEMPT(3), 0, 0);
```
