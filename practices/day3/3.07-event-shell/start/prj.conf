## CMakeLists.txt
```
cmake_minimum_required(VERSION 3.20.0)
find_package(Zephyr REQUIRED HINTS $ENV{ZEPHYR_BASE})
project(day3_event_shell)
target_include_directories(app PRIVATE include)
target_sources(app PRIVATE src/main.c src/event_channels.c src/event_service.c
			   src/event_shell.c src/event_subscriber.c)
```

## prj.conf
```kconfig
CONFIG_PRINTK=y
CONFIG_LOG=y
CONFIG_LOG_MODE_IMMEDIATE=y
CONFIG_LOG_DEFAULT_LEVEL=3
CONFIG_LOG_MAX_LEVEL=4
CONFIG_SHELL=y
CONFIG_SHELL_BACKEND_SERIAL=y
CONFIG_MAIN_STACK_SIZE=2048
CONFIG_SHELL_CMD_BUFF_SIZE=256
CONFIG_ZBUS=y
CONFIG_ZBUS_MSG_SUBSCRIBER=y
CONFIG_HEAP_MEM_POOL_SIZE=1024
CONFIG_ZBUS_MSG_SUBSCRIBER_NET_BUF_POOL_SIZE=32
```

## src/main.c
```c
#include <errno.h>
#include <zephyr/logging/log.h>

#include "event_service.h"

LOG_MODULE_REGISTER(day3_event_shell, LOG_LEVEL_INF);

int main(void)
{
	int ret = event_service_init();

	if (ret != 0) {
		LOG_ERR("Event service initialization failed: %d", ret);
		return ret;
	}
	LOG_INF("Event shell ready. Try: event status, event stats, event reset");
	return 0;
}
```

## include/event_channels.h
```c
#ifndef EVENT_CHANNELS_H
#define EVENT_CHANNELS_H

#include <zephyr/zbus/zbus.h>

#include "event_messages.h"

ZBUS_CHAN_DECLARE(event_cmd_chan);
ZBUS_OBS_DECLARE(event_command_subscriber);

#endif
```

## include/event_messages.h
```c
#ifndef EVENT_MESSAGES_H
#define EVENT_MESSAGES_H

#include <stdint.h>

enum event_command_type {
	EVENT_CMD_START,
	EVENT_CMD_STOP,
	EVENT_CMD_RESET,
	EVENT_CMD_INPUT,
	EVENT_CMD_PULSE,
	EVENT_CMD_BURST,
	EVENT_CMD_CANCEL,
};

struct event_command {
	enum event_command_type type;
	uint32_t sequence;
	int32_t value;
	uint32_t count;
	uint32_t duration_ms;
	uint32_t interval_ms;
};

#endif
```

## src/event_channels.c
```c
#include "event_channels.h"

/* TODO: Attach the message subscriber to the command channel. */
ZBUS_CHAN_DEFINE(event_cmd_chan, struct event_command, NULL, NULL,
		 ZBUS_OBSERVERS_EMPTY,
		 ZBUS_MSG_INIT(.type = EVENT_CMD_START));
```

## src/event_service.c
```c
#include <errno.h>
#include <zephyr/kernel.h>

#include "event_service.h"

K_MUTEX_DEFINE(service_mutex);
static struct event_stats counters;
static bool initialized;
static bool running;
static int last_error;
static uint32_t sequence_number;

int event_service_init(void)
{
	k_mutex_lock(&service_mutex, K_FOREVER);
	/* TODO: Initialize the complete shared service state. */
	initialized = true;
	k_mutex_unlock(&service_mutex);
	return 0;
}

void event_service_set_running(bool active)
{
	k_mutex_lock(&service_mutex, K_FOREVER);
	running = active;
	last_error = 0;
	k_mutex_unlock(&service_mutex);
}

void event_service_record_published(void)
{
	k_mutex_lock(&service_mutex, K_FOREVER);
	counters.cmd_published++;
	k_mutex_unlock(&service_mutex);
}

void event_service_record_received(void)
{
	k_mutex_lock(&service_mutex, K_FOREVER);
	counters.cmd_received++;
	k_mutex_unlock(&service_mutex);
}

void event_service_record_rejected(void)
{
	k_mutex_lock(&service_mutex, K_FOREVER);
	counters.cmd_rejected++;
	last_error = -EINVAL;
	k_mutex_unlock(&service_mutex);
}

uint32_t event_service_next_sequence(void)
{
	k_mutex_lock(&service_mutex, K_FOREVER);
	uint32_t next = ++sequence_number;
	k_mutex_unlock(&service_mutex);
	return next;
}

int event_service_get_status(struct event_status *status)
{
	bool ready;

	if (status == NULL) {
		return -EINVAL;
	}
	k_mutex_lock(&service_mutex, K_FOREVER);
	ready = initialized;
	*status = (struct event_status) {
		.initialized = initialized,
		.running = running,
		.last_error = last_error,
	};
	k_mutex_unlock(&service_mutex);
	return ready ? 0 : -EAGAIN;
}

int event_service_get_stats(struct event_stats *stats)
{
	bool ready;

	if (stats == NULL) {
		return -EINVAL;
	}
	k_mutex_lock(&service_mutex, K_FOREVER);
	ready = initialized;
	*stats = counters;
	k_mutex_unlock(&service_mutex);
	return ready ? 0 : -EAGAIN;
}

int event_service_reset_stats(void)
{
	k_mutex_lock(&service_mutex, K_FOREVER);
	if (!initialized) {
		k_mutex_unlock(&service_mutex);
		return -EAGAIN;
	}
	/* TODO: Reset only the counters; keep the service state. */
	k_mutex_unlock(&service_mutex);
	return -ENOSYS;
}
```

## src/event_shell.c
```c
#include <errno.h>
#include <zephyr/shell/shell.h>

#include "event_channels.h"
#include "event_service.h"

static int cmd_status(const struct shell *sh, size_t argc, char **argv)
{
	struct event_status status;
	int ret;

	ARG_UNUSED(argc);
	ARG_UNUSED(argv);
	ret = event_service_get_status(&status);
	if (ret != 0) {
		shell_error(sh, "status unavailable: %d", ret);
		return ret;
	}
	shell_print(sh, "initialized=%s running=%s last_error=%d",
		    status.initialized ? "yes" : "no", status.running ? "yes" : "no",
		    status.last_error);
	return 0;
}

static int cmd_stats(const struct shell *sh, size_t argc, char **argv)
{
	struct event_stats stats;
	int ret;

	ARG_UNUSED(argc);
	ARG_UNUSED(argv);
	ret = event_service_get_stats(&stats);
	if (ret != 0) {
		shell_error(sh, "stats unavailable: %d", ret);
		return ret;
	}
	shell_print(sh, "cmd_published=%u cmd_received=%u cmd_rejected=%u input_published=%u input_received=%u processed=%u publish_failed=%u last_error=%d",
		    stats.cmd_published, stats.cmd_received, stats.cmd_rejected,
		    stats.input_published, stats.input_received, stats.processed,
		    stats.publish_failed, stats.last_error);
	return 0;
}

static int publish_command(const struct shell *sh, enum event_command_type type)
{
	ARG_UNUSED(type);
	/* TODO: Create, sequence, and publish the requested command. */
	shell_error(sh, "command publisher is not implemented yet");
	return -ENOSYS;
}

static int cmd_start(const struct shell *sh, size_t argc, char **argv)
{
	ARG_UNUSED(argc);
	ARG_UNUSED(argv);
	return publish_command(sh, EVENT_CMD_START);
}

static int cmd_stop(const struct shell *sh, size_t argc, char **argv)
{
	ARG_UNUSED(argc);
	ARG_UNUSED(argv);
	return publish_command(sh, EVENT_CMD_STOP);
}

static int cmd_reset(const struct shell *sh, size_t argc, char **argv)
{
	ARG_UNUSED(argc);
	ARG_UNUSED(argv);
	return publish_command(sh, EVENT_CMD_RESET);
}

SHELL_STATIC_SUBCMD_SET_CREATE(event_commands,
	SHELL_CMD_ARG(status, NULL, "Show event service status", cmd_status, 1, 0),
	SHELL_CMD_ARG(stats, NULL, "Show command statistics", cmd_stats, 1, 0),
	SHELL_CMD_ARG(start, NULL, "Publish start command", cmd_start, 1, 0),
	SHELL_CMD_ARG(stop, NULL, "Publish stop command", cmd_stop, 1, 0),
	SHELL_CMD_ARG(reset, NULL, "Publish reset command", cmd_reset, 1, 0),
	SHELL_SUBCMD_SET_END
);
SHELL_CMD_REGISTER(event, &event_commands, "zbus event command publisher", NULL);
```

## src/event_subscriber.c
```c
#include <zephyr/kernel.h>
#include <zephyr/logging/log.h>

#include "event_channels.h"
#include "event_service.h"

LOG_MODULE_REGISTER(event_subscriber, LOG_LEVEL_INF);

ZBUS_MSG_SUBSCRIBER_DEFINE(event_command_subscriber);

static void subscriber_thread(void *p1, void *p2, void *p3)
{
	const struct zbus_channel *chan;
	struct event_command command;

	ARG_UNUSED(p1);
	ARG_UNUSED(p2);
	ARG_UNUSED(p3);
	while (zbus_sub_wait_msg(&event_command_subscriber, &chan, &command, K_FOREVER) == 0) {
		/* TODO: Validate the channel and apply the command via the service API. */
		if (chan == &event_cmd_chan) {
			event_service_record_received();
			LOG_INF("received command type=%d sequence=%u", command.type, command.sequence);
		}
	}
}

K_THREAD_DEFINE(event_command_subscriber_thread, 1536, subscriber_thread,
		NULL, NULL, NULL, K_PRIO_PREEMPT(3), 0, 0);
```
