## prj.conf
```kconfig
CONFIG_LOG=y
CONFIG_LOG_MODE_IMMEDIATE=y
CONFIG_ZBUS=y
CONFIG_ZBUS_MSG_SUBSCRIBER=y
CONFIG_MAIN_STACK_SIZE=2048
```

## include/event_channels.h
```c
#ifndef EVENT_CHANNELS_H
#define EVENT_CHANNELS_H

#include <zephyr/zbus/zbus.h>

#include "event_messages.h"

ZBUS_CHAN_DECLARE(event_cmd_chan);
ZBUS_CHAN_DECLARE(event_input_chan);

ZBUS_OBS_DECLARE(event_stimulus_subscriber, event_input_listener);

#endif
```

## src/event_input_listener.c
```c
#include <zephyr/logging/log.h>

#include "event_channels.h"

LOG_MODULE_REGISTER(event_input, LOG_LEVEL_INF);

static void input_callback(const struct zbus_channel *chan)
{
	const struct event_input *input = zbus_chan_const_msg(chan);

	LOG_INF("input source=%d sequence=%u active=%d",
		input->source, input->sequence, input->active);
}

ZBUS_LISTENER_DEFINE(event_input_listener, input_callback);
```

## src/event_subscriber.c
```c
#include <zephyr/kernel.h>
#include <zephyr/logging/log.h>

#include "event_channels.h"

LOG_MODULE_REGISTER(event_subscriber, LOG_LEVEL_INF);

ZBUS_MSG_SUBSCRIBER_DEFINE(event_stimulus_subscriber);

static void subscriber_thread(void *p1, void *p2, void *p3)
{
	const struct zbus_channel *chan;
	struct event_command command;

	ARG_UNUSED(p1);
	ARG_UNUSED(p2);
	ARG_UNUSED(p3);
	while (zbus_sub_wait_msg(&event_stimulus_subscriber, &chan, &command, K_FOREVER) == 0) {
		if (chan != &event_cmd_chan) {
			LOG_ERR("unexpected channel");
			continue;
		}
		if (command.type != EVENT_CMD_INPUT) {
			LOG_ERR("unsupported command: %d", command.type);
			continue;
		}
		struct event_input input = {
			.source = EVENT_SOURCE_EMULATED,
			.sequence = command.sequence,
			.active = command.value != 0,
			.timestamp = k_uptime_get(),
		};
		int ret = zbus_chan_pub(&event_input_chan, &input, K_NO_WAIT);

		if (ret != 0) {
			LOG_ERR("input publish failed: %d", ret);
		}
	}
}

K_THREAD_DEFINE(event_subscriber_thread, 1536, subscriber_thread, NULL, NULL, NULL,
		K_PRIO_PREEMPT(3), 0, 0);
```
