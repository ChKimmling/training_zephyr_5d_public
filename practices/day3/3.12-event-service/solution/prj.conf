## prj.conf
```kconfig
CONFIG_PRINTK=y
CONFIG_LOG=y
CONFIG_LOG_MODE_IMMEDIATE=y
CONFIG_LOG_DEFAULT_LEVEL=3
CONFIG_LOG_MAX_LEVEL=4
CONFIG_GPIO=y
CONFIG_SHELL=y
CONFIG_SHELL_BACKEND_SERIAL=y
CONFIG_MAIN_STACK_SIZE=2048
CONFIG_SYSTEM_WORKQUEUE_STACK_SIZE=2048
CONFIG_SHELL_CMD_BUFF_SIZE=256
```

## src/main.c
```c
#include <errno.h>
#include <zephyr/logging/log.h>

#include "event_input.h"
#include "event_service.h"
#include "stimulus.h"

LOG_MODULE_REGISTER(event_service_app, LOG_LEVEL_INF);

int main(void)
{
	int ret = event_service_init();

	if (ret == 0) {
		ret = event_input_init();
	}
	if (ret == 0) {
		ret = stimulus_init(event_input_spec());
	}
	if (ret == 0) {
		ret = event_input_enable();
	}
	if (ret != 0) {
		event_service_set_error(ret);
		LOG_ERR("Event service initialization failed: %d", ret);
		return ret;
	}
	LOG_INF("Interactive event service ready. Try: event status, event stats, event pulse 100");
	return 0;
}
```

## include/event_input.h
```c
#ifndef EVENT_INPUT_H
#define EVENT_INPUT_H

#include <zephyr/drivers/gpio.h>

int event_input_init(void);
const struct gpio_dt_spec *event_input_spec(void);

#endif
```

## include/event_service.h
```c
#ifndef EVENT_SERVICE_H
#define EVENT_SERVICE_H

#include <stdbool.h>
#include <stdint.h>

#include "event_messages.h"

struct event_status {
	bool initialized;
	bool running;
	bool input_ready;
	bool input_active;
	const char *stimulus_state;
	uint32_t remaining;
	int last_error;
};

struct event_stats {
	uint32_t cmd_published;
	uint32_t cmd_received;
	uint32_t cmd_rejected;
	uint32_t input_published;
	uint32_t input_received;
	uint32_t processed;
	uint32_t publish_failed;
	int32_t last_error;
};

int event_service_init(void);
void event_service_set_running(bool running);
bool event_service_is_running(void);
void event_service_record_command_published(void);
void event_service_record_command_received(void);
void event_service_record_input_published(void);
void event_service_record_input_received(void);
void event_service_record_processed(void);
void event_service_record_publish_failure(int error);
uint32_t event_service_next_sequence(void);
void event_service_set_input_ready(bool ready);
void event_service_reject(void);
void event_service_set_error(int error);
int event_service_get_status(struct event_status *status);
int event_service_get_stats(struct event_stats *stats);
int event_service_reset_stats(void);

#endif
```

## src/event_channels.c
```c
#include "event_channels.h"

ZBUS_CHAN_DEFINE(event_cmd_chan, struct event_command, NULL, NULL,
		 ZBUS_OBSERVERS(event_stimulus_subscriber),
		 ZBUS_MSG_INIT(.type = EVENT_CMD_START));
ZBUS_CHAN_DEFINE(event_input_chan, struct event_input, NULL, NULL,
		 ZBUS_OBSERVERS(event_input_listener),
		 ZBUS_MSG_INIT(.source = EVENT_SOURCE_SHELL));
```

## src/event_input.c
```c
#include <errno.h>
#include <zephyr/drivers/gpio.h>
#include <zephyr/kernel.h>

#include "event_channels.h"
#include "event_service.h"

static const struct gpio_dt_spec input =
	GPIO_DT_SPEC_GET(DT_ALIAS(event_input), gpios);
static struct gpio_callback input_callback;

static void input_changed(const struct device *port, struct gpio_callback *callback,
			  gpio_port_pins_t pins)
{
	ARG_UNUSED(port);
	ARG_UNUSED(callback);
	if ((pins & BIT(input.pin)) != 0U) {
		int level = gpio_pin_get_dt(&input);

		if (level < 0) {
			event_service_record_publish_failure(level);
			return;
		}
		if (level == 0) {
			return;
		}
		struct event_input event = {
			.source = EVENT_SOURCE_EMULATED,
			.sequence = event_service_next_sequence(),
			.active = true,
			.timestamp = k_uptime_get(),
		};
		int ret = zbus_chan_pub(&event_input_chan, &event, K_NO_WAIT);

		if (ret == 0) {
			event_service_record_input_published();
		} else {
			event_service_record_publish_failure(ret);
		}
	}
}

int event_input_init(void)
{
	int ret;

	if (!gpio_is_ready_dt(&input)) {
		event_service_set_input_ready(false);
		return -ENODEV;
	}
	ret = gpio_pin_configure_dt(&input, GPIO_INPUT);
	if (ret == 0) {
		gpio_init_callback(&input_callback, input_changed, BIT(input.pin));
		ret = gpio_add_callback(input.port, &input_callback);
	}
	if (ret == 0) {
		event_service_set_input_ready(true);
	} else {
		event_service_set_input_ready(false);
	}
	return ret;
}

int event_input_enable(void)
{
	return gpio_pin_interrupt_configure_dt(&input, GPIO_INT_EDGE_BOTH);
}

int event_input_get_level(bool *active)
{
	int value;

	if (active == NULL) {
		return -EINVAL;
	}
	value = gpio_pin_get_dt(&input);
	if (value < 0) {
		return value;
	}
	*active = value != 0;
	return 0;
}

const struct gpio_dt_spec *event_input_spec(void)
{
	return &input;
}
```

## src/event_input_listener.c
```c
#include <zephyr/logging/log.h>

#include "event_channels.h"
#include "event_service.h"

LOG_MODULE_REGISTER(event_input_listener, LOG_LEVEL_INF);

static void input_callback(const struct zbus_channel *chan, const void *message)
{
	const struct event_input *input = message;

	if (chan != &event_input_chan || input == NULL) {
		LOG_ERR("invalid input notification");
		event_service_set_error(-EINVAL);
		return;
	}
	event_service_record_input_received();
	if (!event_service_is_running()) {
		event_service_reject();
		event_service_set_error(-ESHUTDOWN);
		LOG_WRN("input rejected while service is stopped");
		return;
	}
	LOG_INF("processed input source=%d sequence=%u active=%d",
		input->source, input->sequence, input->active);
	event_service_record_processed();
}

ZBUS_ASYNC_LISTENER_DEFINE(event_input_listener, input_callback);
```

## src/event_service.c
```c
#include <errno.h>
#include <zephyr/kernel.h>

#include "event_service.h"

static struct k_spinlock service_lock;
static struct event_stats counters;
static bool initialized;
static bool running;
static bool input_ready;
static uint32_t sequence_number;

static void increment_counter(uint32_t *counter)
{
	k_spinlock_key_t key = k_spin_lock(&service_lock);

	(*counter)++;
	k_spin_unlock(&service_lock, key);
}

int event_service_init(void)
{
	k_spinlock_key_t key = k_spin_lock(&service_lock);

	counters = (struct event_stats){0};
	sequence_number = 0U;
	running = false;
	input_ready = false;
	initialized = true;
	k_spin_unlock(&service_lock, key);
	return 0;
}

void event_service_set_running(bool active)
{
	k_spinlock_key_t key = k_spin_lock(&service_lock);

	running = active;
	k_spin_unlock(&service_lock, key);
}

bool event_service_is_running(void)
{
	k_spinlock_key_t key = k_spin_lock(&service_lock);
	bool active = running;

	k_spin_unlock(&service_lock, key);
	return active;
}

void event_service_record_command_published(void)
{
	increment_counter(&counters.cmd_published);
}

void event_service_record_command_received(void)
{
	increment_counter(&counters.cmd_received);
}

void event_service_record_input_published(void)
{
	increment_counter(&counters.input_published);
}

void event_service_record_input_received(void)
{
	increment_counter(&counters.input_received);
}

void event_service_record_processed(void)
{
	increment_counter(&counters.processed);
}

void event_service_record_publish_failure(int error)
{
	k_spinlock_key_t key = k_spin_lock(&service_lock);

	counters.publish_failed++;
	counters.last_error = error;
	k_spin_unlock(&service_lock, key);
}

uint32_t event_service_next_sequence(void)
{
	k_spinlock_key_t key = k_spin_lock(&service_lock);
	uint32_t next = ++sequence_number;

	k_spin_unlock(&service_lock, key);
	return next;
}

void event_service_set_input_ready(bool ready)
{
	k_spinlock_key_t key = k_spin_lock(&service_lock);

	input_ready = ready;
	k_spin_unlock(&service_lock, key);
}

void event_service_reject(void)
{
	increment_counter(&counters.cmd_rejected);
}

void event_service_set_error(int error)
{
	k_spinlock_key_t key = k_spin_lock(&service_lock);

	counters.last_error = error;
	k_spin_unlock(&service_lock, key);
}

int event_service_get_status(struct event_status *status)
{
	if (status == NULL) {
		return -EINVAL;
	}
	k_spinlock_key_t key = k_spin_lock(&service_lock);
	bool ready = initialized;

	status->initialized = initialized;
	status->running = running;
	status->input_ready = input_ready;
	status->input_active = false;
	status->stimulus_state = "idle";
	status->remaining = 0U;
	status->last_error = counters.last_error;
	k_spin_unlock(&service_lock, key);
	return ready ? 0 : -EAGAIN;
}

int event_service_get_stats(struct event_stats *stats)
{
	if (stats == NULL) {
		return -EINVAL;
	}
	k_spinlock_key_t key = k_spin_lock(&service_lock);
	bool ready = initialized;

	*stats = counters;
	k_spin_unlock(&service_lock, key);
	return ready ? 0 : -EAGAIN;
}

int event_service_reset_stats(void)
{
	k_spinlock_key_t key = k_spin_lock(&service_lock);

	if (!initialized) {
		k_spin_unlock(&service_lock, key);
		return -EAGAIN;
	}
	counters = (struct event_stats){0};
	k_spin_unlock(&service_lock, key);
	return 0;
}
```

## src/event_shell.c
```c
#include <errno.h>
#include <stdlib.h>
#include <zephyr/shell/shell.h>

#include "event_channels.h"
#include "event_service.h"
#include "stimulus.h"

static int parse_u32(const struct shell *sh, const char *text, uint32_t min,
		     uint32_t max, uint32_t *value)
{
	const char *digit;
	char *end;
	unsigned long parsed;

	if (text == NULL || text[0] == '\0') {
		event_service_reject();
		event_service_set_error(-EINVAL);
		shell_error(sh, "expected an unsigned integer");
		return -EINVAL;
	}
	for (digit = text; *digit != '\0'; digit++) {
		if (*digit < '0' || *digit > '9') {
			event_service_reject();
			event_service_set_error(-EINVAL);
			shell_error(sh, "expected an unsigned integer");
			return -EINVAL;
		}
	}
	errno = 0;
	parsed = strtoul(text, &end, 10);
	if (errno != 0 || end == text || *end != '\0' || parsed < min || parsed > max) {
		event_service_reject();
		event_service_set_error(-ERANGE);
		shell_error(sh, "value must be in range %u..%u", min, max);
		return -ERANGE;
	}
	*value = (uint32_t)parsed;
	return 0;
}

static int publish_command(const struct shell *sh, struct event_command *command)
{
	command->sequence = event_service_next_sequence();
	int ret = zbus_chan_pub(&event_cmd_chan, command, K_NO_WAIT);

	if (ret != 0) {
		event_service_record_publish_failure(ret);
		shell_error(sh, "command publish failed: %d", ret);
		return ret;
	}
	event_service_record_command_published();
	shell_print(sh, "command sequence=%u published", command->sequence);
	return 0;
}

static int cmd_status(const struct shell *sh, size_t argc, char **argv)
{
	struct event_status status;
	bool input_active;
	const char *mode;
	uint32_t remaining;
	int ret;

	ARG_UNUSED(argc);
	ARG_UNUSED(argv);
	ret = event_service_get_status(&status);
	if (ret != 0) {
		shell_error(sh, "status unavailable: %d", ret);
		return ret;
	}
	stimulus_get_status(&input_active, &mode, &remaining);
	shell_print(sh, "initialized=%s running=%s input_ready=%s input=%s stimulus=%s remaining=%u last_error=%d",
		    status.initialized ? "yes" : "no", status.running ? "yes" : "no",
		    status.input_ready ? "yes" : "no",
		    input_active ? "active" : "idle", mode, remaining, status.last_error);
	return 0;
}

static int cmd_stats(const struct shell *sh, size_t argc, char **argv)
{
	struct event_stats stats;
	int ret;

	ARG_UNUSED(argc);
	ARG_UNUSED(argv);
	ret = event_service_get_stats(&stats);
	if (ret != 0) {
		shell_error(sh, "stats unavailable: %d", ret);
		return ret;
	}
	shell_print(sh, "cmd_published=%u cmd_received=%u cmd_rejected=%u input_published=%u input_received=%u processed=%u publish_failed=%u last_error=%d",
		    stats.cmd_published, stats.cmd_received, stats.cmd_rejected,
		    stats.input_published, stats.input_received, stats.processed,
		    stats.publish_failed, stats.last_error);
	return 0;
}

static int cmd_simple(const struct shell *sh, size_t argc, char **argv,
		      enum event_command_type type)
{
	struct event_command command = {.type = type};

	ARG_UNUSED(argc);
	ARG_UNUSED(argv);
	return publish_command(sh, &command);
}

static int cmd_start(const struct shell *sh, size_t argc, char **argv)
{
	return cmd_simple(sh, argc, argv, EVENT_CMD_START);
}

static int cmd_stop(const struct shell *sh, size_t argc, char **argv)
{
	return cmd_simple(sh, argc, argv, EVENT_CMD_STOP);
}

static int cmd_reset(const struct shell *sh, size_t argc, char **argv)
{
	return cmd_simple(sh, argc, argv, EVENT_CMD_RESET);
}

static int cmd_input(const struct shell *sh, size_t argc, char **argv)
{
	struct event_command command = {.type = EVENT_CMD_INPUT};
	uint32_t value;
	int ret;

	ARG_UNUSED(argc);
	ret = parse_u32(sh, argv[1], 0U, 1U, &value);
	if (ret != 0) {
		return ret;
	}
	command.value = (int32_t)value;
	return publish_command(sh, &command);
}

static int cmd_pulse(const struct shell *sh, size_t argc, char **argv)
{
	struct event_command command = {
		.type = EVENT_CMD_PULSE,
		.duration_ms = 100U,
	};
	int ret = 0;

	if (argc > 1U) {
		ret = parse_u32(sh, argv[1], 20U, 2000U, &command.duration_ms);
	}
	return ret != 0 ? ret : publish_command(sh, &command);
}

static int cmd_burst(const struct shell *sh, size_t argc, char **argv)
{
	struct event_command command = {.type = EVENT_CMD_BURST};
	int ret;

	ARG_UNUSED(argc);
	ret = parse_u32(sh, argv[1], 1U, 20U, &command.count);
	if (ret == 0) {
		ret = parse_u32(sh, argv[2], 20U, 2000U, &command.interval_ms);
	}
	return ret != 0 ? ret : publish_command(sh, &command);
}

static int cmd_cancel(const struct shell *sh, size_t argc, char **argv)
{
	return cmd_simple(sh, argc, argv, EVENT_CMD_CANCEL);
}

SHELL_STATIC_SUBCMD_SET_CREATE(event_commands,
	SHELL_CMD_ARG(status, NULL, "Show service status", cmd_status, 1, 0),
	SHELL_CMD_ARG(stats, NULL, "Show event statistics", cmd_stats, 1, 0),
	SHELL_CMD_ARG(start, NULL, "Start accepting input events", cmd_start, 1, 0),
	SHELL_CMD_ARG(stop, NULL, "Stop accepting input events", cmd_stop, 1, 0),
	SHELL_CMD_ARG(reset, NULL, "Reset statistics", cmd_reset, 1, 0),
	SHELL_CMD_ARG(input, NULL, "Publish a logical input: 0 or 1", cmd_input, 2, 0),
	SHELL_CMD_ARG(pulse, NULL, "Publish a pulse: optional duration in ms", cmd_pulse, 1, 2),
	SHELL_CMD_ARG(burst, NULL, "Publish count and interval in ms", cmd_burst, 3, 0),
	SHELL_CMD_ARG(cancel, NULL, "Cancel active stimulus", cmd_cancel, 1, 0),
	SHELL_SUBCMD_SET_END
);
SHELL_CMD_REGISTER(event, &event_commands, "Integrated zbus event service", NULL);
```

## src/stimulus.c
```c
#include <errno.h>
#include <zephyr/drivers/gpio/gpio_emul.h>
#include <zephyr/kernel.h>

#include "event_service.h"
#include "stimulus.h"

#define PULSE_WIDTH_MS 100U
#define PULSE_MIN_MS 20U
#define PULSE_MAX_MS 2000U
#define BURST_MAX_COUNT 20U
#define GAP_MIN_MS 20U
#define GAP_MAX_MS 2000U

enum sequence_mode {
	SEQUENCE_IDLE,
	SEQUENCE_PULSE,
	SEQUENCE_BURST,
};

static struct gpio_dt_spec input;
K_MUTEX_DEFINE(stimulus_mutex);
static struct k_work_delayable sequence_work;
static enum sequence_mode mode;
static bool input_active;
static bool phase_active;
static uint32_t remaining;
static uint32_t pulse_duration_ms;
static uint32_t gap_ms;

static int set_level_locked(bool active)
{
	int ret = gpio_emul_input_set_dt(&input, active ? 1 : 0);

	if (ret == 0) {
		input_active = active;
		event_service_set_error(0);
	} else {
		event_service_set_error(ret);
	}
	return ret;
}

static void sequence_handler(struct k_work *work)
{
	int ret = 0;

	ARG_UNUSED(work);
	k_mutex_lock(&stimulus_mutex, K_FOREVER);
	if (mode == SEQUENCE_IDLE) {
		k_mutex_unlock(&stimulus_mutex);
		return;
	}
	if (phase_active) {
		ret = set_level_locked(false);
		phase_active = false;
		if (mode == SEQUENCE_PULSE || remaining <= 1U) {
			mode = SEQUENCE_IDLE;
			remaining = 0U;
		} else {
			remaining--;
			k_work_reschedule(&sequence_work, K_MSEC(gap_ms));
		}
	} else {
		ret = set_level_locked(true);
		if (ret == 0) {
			phase_active = true;
			k_work_reschedule(&sequence_work, K_MSEC(PULSE_WIDTH_MS));
		}
	}
	if (ret != 0) {
		(void)set_level_locked(false);
		mode = SEQUENCE_IDLE;
		remaining = 0U;
		phase_active = false;
	}
	k_mutex_unlock(&stimulus_mutex);
}

int stimulus_init(const struct gpio_dt_spec *gpio)
{
	int ret;

	if (gpio == NULL || !gpio_is_ready_dt(gpio)) {
		return -ENODEV;
	}
	input = *gpio;
	k_work_init_delayable(&sequence_work, sequence_handler);
	k_mutex_lock(&stimulus_mutex, K_FOREVER);
	mode = SEQUENCE_IDLE;
	input_active = false;
	remaining = 0U;
	ret = set_level_locked(false);
	k_mutex_unlock(&stimulus_mutex);
	return ret;
}

int stimulus_set_input(bool active)
{
	int ret;

	k_mutex_lock(&stimulus_mutex, K_FOREVER);
	if (mode != SEQUENCE_IDLE) {
		k_mutex_unlock(&stimulus_mutex);
		return -EBUSY;
	}
	ret = set_level_locked(active);
	k_mutex_unlock(&stimulus_mutex);
	return ret;
}

int stimulus_start_pulse(uint32_t duration_ms)
{
	int ret;

	if (duration_ms < PULSE_MIN_MS || duration_ms > PULSE_MAX_MS) {
		return -ERANGE;
	}
	k_mutex_lock(&stimulus_mutex, K_FOREVER);
	if (mode != SEQUENCE_IDLE) {
		k_mutex_unlock(&stimulus_mutex);
		return -EBUSY;
	}
	mode = SEQUENCE_PULSE;
	remaining = 1U;
	pulse_duration_ms = duration_ms;
	ret = set_level_locked(false);
	if (ret == 0) {
		ret = set_level_locked(true);
	}
	if (ret == 0) {
		phase_active = true;
		k_work_reschedule(&sequence_work, K_MSEC(pulse_duration_ms));
	} else {
		mode = SEQUENCE_IDLE;
		remaining = 0U;
	}
	k_mutex_unlock(&stimulus_mutex);
	return ret;
}

int stimulus_start_burst(uint32_t count, uint32_t gap_interval_ms)
{
	int ret;

	if (count == 0U || count > BURST_MAX_COUNT ||
	    gap_interval_ms < GAP_MIN_MS || gap_interval_ms > GAP_MAX_MS) {
		return -ERANGE;
	}
	k_mutex_lock(&stimulus_mutex, K_FOREVER);
	if (mode != SEQUENCE_IDLE) {
		k_mutex_unlock(&stimulus_mutex);
		return -EBUSY;
	}
	mode = SEQUENCE_BURST;
	remaining = count;
	gap_ms = gap_interval_ms;
	ret = set_level_locked(false);
	if (ret == 0) {
		ret = set_level_locked(true);
	}
	if (ret == 0) {
		phase_active = true;
		k_work_reschedule(&sequence_work, K_MSEC(PULSE_WIDTH_MS));
	} else {
		mode = SEQUENCE_IDLE;
		remaining = 0U;
	}
	k_mutex_unlock(&stimulus_mutex);
	return ret;
}

int stimulus_cancel(void)
{
	int ret;

	(void)k_work_cancel_delayable(&sequence_work);
	k_mutex_lock(&stimulus_mutex, K_FOREVER);
	ret = set_level_locked(false);
	mode = SEQUENCE_IDLE;
	remaining = 0U;
	phase_active = false;
	k_mutex_unlock(&stimulus_mutex);
	return ret;
}

void stimulus_get_status(bool *active, const char **mode_name, uint32_t *left)
{
	k_mutex_lock(&stimulus_mutex, K_FOREVER);
	if (active != NULL) {
		*active = input_active;
	}
	if (left != NULL) {
		*left = remaining;
	}
	if (mode_name != NULL) {
		*mode_name = mode == SEQUENCE_PULSE ? "pulse" :
			     mode == SEQUENCE_BURST ? "burst" : "idle";
	}
	k_mutex_unlock(&stimulus_mutex);
}
```

## src/stimulus_subscriber.c
```c
#include <errno.h>
#include <zephyr/kernel.h>
#include <zephyr/logging/log.h>

#include "event_channels.h"
#include "event_service.h"
#include "stimulus.h"

LOG_MODULE_REGISTER(stimulus_subscriber, LOG_LEVEL_INF);

ZBUS_MSG_SUBSCRIBER_DEFINE(event_stimulus_subscriber);

static void reject_command(int error)
{
	event_service_reject();
	event_service_set_error(error);
}

static void process_command(const struct event_command *command)
{
	int ret = 0;

	switch (command->type) {
	case EVENT_CMD_START:
		event_service_set_running(true);
		event_service_set_error(0);
		break;
	case EVENT_CMD_STOP:
		event_service_set_running(false);
		ret = stimulus_cancel();
		break;
	case EVENT_CMD_RESET:
		ret = event_service_reset_stats();
		break;
	case EVENT_CMD_INPUT:
	case EVENT_CMD_PULSE:
	case EVENT_CMD_BURST:
		if (!event_service_is_running()) {
			ret = -ESHUTDOWN;
			break;
		}
		if (command->type == EVENT_CMD_INPUT) {
			ret = stimulus_set_input(command->value != 0);
		} else if (command->type == EVENT_CMD_PULSE) {
			ret = stimulus_start_pulse(command->duration_ms);
		} else {
			ret = stimulus_start_burst(command->count, command->interval_ms);
		}
		break;
	case EVENT_CMD_CANCEL:
		ret = stimulus_cancel();
		break;
	default:
		ret = -EINVAL;
		break;
	}
	if (ret != 0) {
		reject_command(ret);
		LOG_WRN("command type=%d rejected: %d", command->type, ret);
	} else {
		event_service_set_error(0);
	}
}

static void subscriber_thread(void *p1, void *p2, void *p3)
{
	const struct zbus_channel *chan;
	struct event_command command;

	ARG_UNUSED(p1);
	ARG_UNUSED(p2);
	ARG_UNUSED(p3);
	while (zbus_sub_wait_msg(&event_stimulus_subscriber, &chan, &command, K_FOREVER) == 0) {
		if (chan != &event_cmd_chan) {
			reject_command(-EINVAL);
			continue;
		}
		event_service_record_command_received();
		LOG_DBG("received command type=%d sequence=%u", command.type, command.sequence);
		process_command(&command);
	}
}

K_THREAD_DEFINE(event_stimulus_subscriber_thread, 2048, subscriber_thread,
		NULL, NULL, NULL, K_PRIO_PREEMPT(3), 0, 0);
```
