/ {
	aliases {
		event-input = &event_input;
	};

	buttons {
		compatible = "gpio-keys";

		event_input: event_input {
			gpios = <&gpio0 13 (GPIO_PULL_DOWN | GPIO_ACTIVE_HIGH)>;
			label = "External active-high event input";
		};
	};
};
